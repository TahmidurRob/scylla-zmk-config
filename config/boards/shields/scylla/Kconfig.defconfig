## config/boards/shields/scylla/Kconfig.defconfig
```kconfig
# Copyright (c) 2020 Derek Schmell
# SPDX-License-Identifier: MIT
 
 
if SHIELD_SCYLLA_LEFT

config ZMK_KEYBOARD_NAME
	default "scylla"

config ZMK_SPLIT_BLE_ROLE_CENTRAL
	default y

endif

if SHIELD_SCYLLA_RIGHT

config ZMK_KEYBOARD_NAME
	default "scylla Right"

endif

if SHIELD_SCYLLA_LEFT || SHIELD_SCYLLA_RIGHT

config ZMK_SPLIT
	default y
	
endif
```
